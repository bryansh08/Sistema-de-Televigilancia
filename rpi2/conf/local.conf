## rpi2/conf/local.conf
```bitbake
MACHINE ??= "qemux86"
DISTRO ?= "poky"
PACKAGE_CLASSES ?= "package_rpm"
EXTRA_IMAGE_FEATURES ?= "debug-tweaks"
USER_CLASSES ?= "buildstats image-mklibs image-prelink"
PATCHRESOLVE = "noop"

BB_DISKMON_DIRS ??= "\
    STOPTASKS,${TMPDIR},1G,100K \
    STOPTASKS,${DL_DIR},1G,100K \
    STOPTASKS,${SSTATE_DIR},1G,100K \
    STOPTASKS,/tmp,100M,100K \
    ABORT,${TMPDIR},100M,1K \
    ABORT,${DL_DIR},100M,1K \
    ABORT,${SSTATE_DIR},100M,1K \
    ABORT,/tmp,10M,1K"

PACKAGECONFIG_append_pn-qemu-native = " sdl"
PACKAGECONFIG_append_pn-nativesdk-qemu = " sdl"

CONF_VERSION = "1"
MACHINE ?= "raspberrypi3"
INHERIT += "rm_work"
DL_DIR ?= "/home/paula/poky-sumo/downloads"
VIDEO_CAMERA = "1"
EXTRA_IMAGE_FEATURES += "ssh-server-openssh"
#Recetas
IMAGE_INSTALL_append = " python3"
IMAGE_INSTALL_append = " python3-numpy"
IMAGE_INSTALL_append = " python3-datetime"
IMAGE_INSTALL_append = " python3-misc"
IMAGE_INSTALL_append = " python3-core"
#No lo detecto
IMAGE_INSTALL_append = " python3-tkinter" 
#No lo detecto
CORE_IMAGE_EXTRA_INSTALL += "tk" 
IMAGE_INSTALL_append = " python-progra"
IMAGE_INSTALL_append = " gstreamer1.0"
IMAGE_INSTALL_append = " gstreamer1.0-plugins-base"
IMAGE_INSTALL_append = " gstreamer1.0-plugins-good"
IMAGE_INSTALL_append = " gstreamer1.0-plugins-bad"
IMAGE_INSTALL_append = " gstreamer1.0-plugins-ugly"
LICENSE_FLAGS_WHITELIST = "commercial"
IMAGE_INSTALL_append = " v4l-utils"
PACKAGECONFIG_append_pn-gst-plugins-good = "v4l"
DISTRO_FEATURES_append = " x11"
EXTRA_IMAGE_FEATURES += "x11" 
CORE_IMAGE_EXTRA_INSTALL += "opencv"
CORE_IMAGE_EXTRA_INSTALL += "libopencv-core"
CORE_IMAGE_EXTRA_INSTALL += "libopencv-imgproc"
CORE_IMAGE_EXTRA_INSTALL += "libopencv-highgui"
CORE_IMAGE_EXTRA_INSTALL += "libopencv-objdetect"
```
